## yocto_layers/build/conf/bblayers.conf
```bitbake
# POKY_BBLAYERS_CONF_VERSION is increased each time build/conf/bblayers.conf
# changes incompatibly
POKY_BBLAYERS_CONF_VERSION = "2"

BBPATH = "${TOPDIR}"
BBFILES ?= ""

BBLAYERS ?= " \
  /home/builder/workspace/poky/meta \
  /home/builder/workspace/poky/meta-poky \
  /home/builder/workspace/poky/meta-yocto-bsp \
  /home/builder/workspace/meta-openembedded/meta-oe \
  /home/builder/workspace/meta-openembedded/meta-python \
  /home/builder/workspace/meta-st-stm32mp \
  /home/builder/workspace/meta-universal-controller \
  "
```
